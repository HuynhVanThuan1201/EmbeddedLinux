## Kernel_Buổi 15/module_hello/Kconfig
```kconfig
menu "Hello kernel module"

config DEVLINUX_HELLO
	tristate "hello kernel module"
	depends on ARM64
	default m if ARM64
	help
		Select this option to run hello kernel module.

endmenu
```
